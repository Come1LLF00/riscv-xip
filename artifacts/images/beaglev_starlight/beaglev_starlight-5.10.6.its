## artifacts/images/beaglev_starlight/beaglev_starlight-5.10.6.its
```
/dts-v1/;

/ {
        description = "U-boot FIT image for HiFive Nvdla";
        #address-cells = <2>;

        images {
                vmlinux@1 {
                        description = "vmlinux";
                        data = /incbin/("fits/original.fit_vmlinux");
                        type = "kernel";
                        arch = "riscv";
                        os = "linux";
                        compression = "none";
                        load = <0x80200000>;
                        entry = <0x80200000>;
                };
                ramdisk@1 {
                        description = "buildroot initramfs";
                        data = /incbin/("fits/original.fit_ramdisk");
                        type = "ramdisk";
                        arch = "riscv";
                        os = "linux";
                        compression = "none";
                        load = <0x86100000>;
                };
                fdt@1 {
                        description = "unavailable";
                        data = /incbin/("fits/original.fit_fdt");
                        type = "flat_dt";
                        arch = "riscv";
                        compression = "none";
                        load = <0x86000000>;
                };
        };

        configurations {
                default = "config-1";
                config-1 {
                        description = "HiFive Nvdla with opensbi";
                        kernel = "vmlinux@1";
                        ramdisk = "ramdisk@1";
                        fdt = "fdt@1";
                };
        };

};             
```

## artifacts/images/beaglev_starlight/beaglev_starlight-5.17-rc8.its
```
/dts-v1/;

/ {
        description = "U-boot FIT image for HiFive Nvdla";
        #address-cells = <2>;

        images {
                vmlinux {
                        description = "vmlinux";
                        data = /incbin/("5.17-rc8/arch/riscv/boot/Image");
                        type = "kernel";
                        arch = "riscv";
                        os = "linux";
                        compression = "none";
                        load = <0x80200000>;
                        entry = <0x80200000>;
                };
                ramdisk {
                        description = "buildroot initramfs";
                        data = /incbin/("fits/original.fit_ramdisk");
                        type = "ramdisk";
                        arch = "riscv";
                        os = "linux";
                        compression = "none";
                        load = <0x86100000>;
                };
                fdt {
                        description = "unavailable";
                        data = /incbin/("fits/original.fit_fdt");
                        type = "flat_dt";
                        arch = "riscv";
                        compression = "none";
                        load = <0x86000000>;
                };
        };

        configurations {
                default = "config-1";
                config-1 {
                        description = "HiFive Nvdla with opensbi";
                        kernel = "vmlinux";
                        ramdisk = "ramdisk";
                        fdt = "fdt";
                };
        };

};             
```

## artifacts/images/microchip-polarfire-icicle-kit/fits/icicle-kit.its
```
/dts-v1/;

/ {
        description = "MPFS Icicle Kit FIT Image";
        #address-cells = <2>;

        images {
                kernel {
                        description = "Kernel";
                        data = /incbin/("built-images/polarfire/arch/riscv/boot/Image");
                        type = "kernel";
                        arch = "riscv";
                        os = "linux";
                        compression = "none";
                        load = <0x80200000>;
                        entry = <0x80200000>;
                };
                fdt {
                        description = "DTB";
                        data = /incbin/("built-images/icicle-originals/fdt@microchip_icicle-kit-es-a000-microchip.dtb");
                        type = "flat_dt";
                        arch = "riscv";
                        compression = "none";
                        load = <0x82200000>;
                };
                ramdisk {
                        description = "ramdisk Image";
                        data = /incbin/("built-images/icicle-originals/ramdisk@initramfs.cpio.gz");
                        type = "ramdisk";
                        arch = "riscv";
                        os = "linux";
                        compression = "none";
                        load = <0x84000000>;
                };
        };

        configurations {
                default = "standard";
                standard {
                        description = "Standard Boot";
                        kernel = "kernel";
                        fdt = "fdt";
                        ramdisk = "ramdisk";
                        hash {
                                algo = "sha1";
                        };
                };
        };

};             
```

## artifacts/images/mpfs-icicle-kit/icicle-kit-5.6.16.its
```
/dts-v1/;

/ {
        description = "MPFS Icicle Kit FIT Image";
        #address-cells = <2>;

        images {
                kernel@1 {
                        description = "Linux kernel";
                        data = /incbin/("fits/official-mpfs-icicle-kit-5.6.16-fitImage_kernel");
                        type = "kernel";
                        arch = "riscv";
                        os = "linux";
                        compression = "none";
                        load = <0x80200000>;
                        entry = <0x80200000>;
                };
                ramdisk@initramfs.cpio.gz {
                        description = "buildroot initramfs";
                        data = /incbin/("fits/official-mpfs-icicle-kit-5.6.16-fitImage_ramdisk");
                        type = "ramdisk";
                        arch = "riscv";
                        os = "linux";
                        compression = "unknown";
                        load = <0x84000000>;
                };
                fdt@microchip_icicle-kit-es-a000-microchip.dtb {
                        description = "Flattened Device Tree blob";
                        data = /incbin/("fits/official-mpfs-icicle-kit-5.6.16-fitImage_fdt");
                        type = "flat_dt";
                        arch = "riscv";
                        compression = "none";
                        load = <0x82200000>;
                };
        };

        configurations {
                default = "conf@microchip_icicle-kit-es-a000-microchip.dtb";
                conf@microchip_icicle-kit-es-a000-microchip.dtb {
                        description = "1 Linux kernel, FDT blob";
                        kernel = "kernel@1";
                        ramdisk = "ramdisk@initramfs.cpio.gz";
                        fdt = "fdt@microchip_icicle-kit-es-a000-microchip.dtb";
                };
        };

};             
```
